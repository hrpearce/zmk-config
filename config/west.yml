## config/west.yml
```yaml
manifest:
  remotes:
    - name: zmkfirmware
      url-base: https://github.com/matulaaak
  projects:
    - name: zmk
      remote: zmkfirmware
      revision: mouse-pr-acceleration
      import: app/west.yml
  self:
    path: config
```
